## package/ab_ops/Config.in
```kconfig
config BR2_PACKAGE_AB_OPS
	bool "ab_ops"
	help
	  Standalone status/revert/validate helper for fwup-ops.conf - fwup
	  can't branch on which slot is active or feed a subprocess's output
	  back into info(), so this does it natively. See package source.
```

## package/ufs_boot_lun/Config.in
```kconfig
config BR2_PACKAGE_UFS_BOOT_LUN
	bool "ufs_boot_lun"
	help
	  Reads/writes bBootLunEn (which UFS boot LUN ABL reads at power-on)
	  via the kernel's UFS BSG ioctl. Needed alongside the GPT write for
	  real Qualcomm-ABL A/B - see fwup.conf.
```
